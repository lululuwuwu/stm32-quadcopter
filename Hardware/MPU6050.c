#include "stm32f10x.h"                  // Device header
//#include "MyI2C.h"
#include "MPU6050.h"




//封装指定寄存器写入值
void MPU6050_Write_Reg_Value(uint8_t regAddr,uint8_t regValue)
{
	//1.开始
//	MyI2C_Start();
	
	//2.指定地址写 
//	MyI2C_SendByte(0x68<<1 | 0x00);  // 7位地址 + 1位的读写位
	//3.接收MPU6050的应答
//	MyI2C_RecACK();
	//4.发送寄存器地址
//	MyI2C_SendByte(regAddr);	
	//5.接收MPU6050的应答
//	MyI2C_RecACK();
	//6.发送寄存器数据
//	MyI2C_SendByte(regValue);
	//7.接收MPU6050的应答
//	MyI2C_RecACK();
	//8.停止
//	MyI2C_Stop();
	
	//1.开始
	I2C_GenerateSTART(I2C2,ENABLE);
	//等待EV5事件
	while(I2C_CheckEvent(I2C2,I2C_EVENT_MASTER_MODE_SELECT)!=SUCCESS);
	
	//2.指定地址写 
	I2C_Send7bitAddress(I2C2,0x68<<1,I2C_Direction_Transmitter);
	//等待EV6事件
	while(I2C_CheckEvent(I2C2,I2C_EVENT_MASTER_TRANSMITTER_MODE_SELECTED)!=SUCCESS);
	
	//3.发送寄存器地址
	while(I2C_CheckEvent(I2C2,I2C_EVENT_MASTER_BYTE_TRANSMITTING)!=SUCCESS); //等待数据寄存器空
	I2C_SendData(I2C2,regAddr);
	
	//4.发送寄存器数据
	while(I2C_CheckEvent(I2C2,I2C_EVENT_MASTER_BYTE_TRANSMITTING)!=SUCCESS); //等待数据寄存器空
	I2C_SendData(I2C2,regValue);
	
	//5.发送停止
	while(I2C_CheckEvent(I2C2,I2C_EVENT_MASTER_BYTE_TRANSMITTED)!=SUCCESS); //等待数据寄存器空，移位寄存器空
	I2C_GenerateSTOP(I2C2,ENABLE);
	
}

//封装指定寄存器读值
uint8_t MPU6050_Read_Reg_Value(uint8_t regAddr)
{
	//1.开始
//	MyI2C_Start();
//	//2.指定地址写 
//	MyI2C_SendByte(0x68<<1 | 0x00);  // 7位地址 + 1位的读写位
//	//3.接收MPU6050的应答
//	uint8_t ack = MyI2C_RecACK();
//	//4.发送寄存器地址
//	MyI2C_SendByte(regAddr);
//	//5.接收MPU6050的应答
//	MyI2C_RecACK();
//	//6.发一个开始
//	MyI2C_Start();
//	//7.指定地址读
//	MyI2C_SendByte(0x68<<1 | 0x01);  // 7位地址 + 1位的读写位
//	//8.接收MPU6050的应答
//	MyI2C_RecACK();
//	//9.接收MPU6050的字节
//	uint8_t regValue= MyI2C_RecByte();
//	//10.STM32发送非应答
//	MyI2C_SendACK(1);	
//	//11.协议结束
//	MyI2C_Stop();
//	
//	return regValue;
	
	//1.开始
	I2C_GenerateSTART(I2C2,ENABLE);
	//等待EV5事件
	while(I2C_CheckEvent(I2C2,I2C_EVENT_MASTER_MODE_SELECT)!=SUCCESS);	
	//2.指定地址写 
	I2C_Send7bitAddress(I2C2,0x68<<1,I2C_Direction_Transmitter);
	//等待EV6事件
	while(I2C_CheckEvent(I2C2,I2C_EVENT_MASTER_TRANSMITTER_MODE_SELECTED)!=SUCCESS);
	
	//3.发送寄存器地址
	while(I2C_CheckEvent(I2C2,I2C_EVENT_MASTER_BYTE_TRANSMITTING)!=SUCCESS); //等待数据寄存器空
	I2C_SendData(I2C2,regAddr);	
	
	
	//5.发送重复的开始信号
	I2C_GenerateSTART(I2C2,ENABLE);
	//等待EV5事件
	while(I2C_CheckEvent(I2C2,I2C_EVENT_MASTER_MODE_SELECT)!=SUCCESS);	
	//6.指定地址读 
	I2C_Send7bitAddress(I2C2,0x68<<1,I2C_Direction_Receiver);	 //接收模式
	//等待EV6事件
	while(I2C_CheckEvent(I2C2,I2C_EVENT_MASTER_RECEIVER_MODE_SELECTED)!=SUCCESS);	//接收模式
	
	//只接收一个字节要按照EV6_1事件操作
	//EV6_1：没有对应的事件标志，只适于接收1个字节的情况。恰好在EV6之后(即清除了ADDR之后)，要清除响应和停止条件的产生位。
	//(1)清除响应
	I2C_AcknowledgeConfig(I2C2,DISABLE);
	//(2)停止条件的产生位
	I2C_GenerateSTOP(I2C2,ENABLE);
	
	//等待EV7事件
	while(I2C_CheckEvent(I2C2,I2C_EVENT_MASTER_BYTE_RECEIVED)!=SUCCESS);
	uint8_t regValue= I2C_ReceiveData(I2C2);
	
	
	
	I2C_AcknowledgeConfig(I2C2,ENABLE);//操作完毕后再打开，防止调用其他函数不能自动应答ack
	return regValue;	
	
}




void MPU6050_Init(void)
{
//	MyI2C_Init();
	
	//开启时钟：
	RCC_APB2PeriphClockCmd(RCC_APB2Periph_GPIOB,ENABLE);
	RCC_APB1PeriphClockCmd(RCC_APB1Periph_I2C2,ENABLE);
	
	//GPIO初始化
	GPIO_InitTypeDef GPIO_InitTypeStructure;
	GPIO_InitTypeStructure.GPIO_Mode = GPIO_Mode_AF_OD; //模式：开漏复用输出
	GPIO_InitTypeStructure.GPIO_Pin = GPIO_Pin_10 | GPIO_Pin_11;
	GPIO_InitTypeStructure.GPIO_Speed = GPIO_Speed_50MHz;
	
	GPIO_Init(GPIOB,&GPIO_InitTypeStructure);
	
	//IIC初始化
	I2C_InitTypeDef I2C_InitTypeStructure;
	I2C_InitTypeStructure.I2C_Ack = I2C_Ack_Enable; //自动发送应答 或 自动接收应答
	I2C_InitTypeStructure.I2C_AcknowledgedAddress = I2C_AcknowledgedAddress_7bit; // ACK是7位地址的
	I2C_InitTypeStructure.I2C_ClockSpeed = 100000; //时钟频率： lower than 400kHz
	I2C_InitTypeStructure.I2C_DutyCycle = I2C_DutyCycle_16_9; // 快速模式下才用的上。 低电平/高电平 
	I2C_InitTypeStructure.I2C_Mode = I2C_Mode_I2C; // I2C模式
	I2C_InitTypeStructure.I2C_OwnAddress1 = 0x02;//STM32的自己的I2C地址，设置的时候不要和从机重复即可。	
	
	I2C_Init(I2C2,&I2C_InitTypeStructure);
	
	//IIC启动
	I2C_Cmd(I2C2,ENABLE);
	
	
	//对产品进行配置
	//1.每次调用Init方法先初始化配置再说。
	/*DEVICE_RESET 
		When set to 1, this bit resets all internal registers to their default values. 
		The bit automatically clears to 0 once the reset is done. 
		The default values for each register can be found in Section 3.
	*/
	MPU6050_Write_Reg_Value(MPU6050_PWR_MGMT_1,0x80);
	for(uint32_t i=0;i<999999;i++);//稍微等一下
	while((MPU6050_Read_Reg_Value(MPU6050_PWR_MGMT_1)&0x80)!=0x00);	

	
	//2.禁用Sleep，使用陀螺仪x轴时钟
	MPU6050_Write_Reg_Value(MPU6050_PWR_MGMT_1,0x01);
	//3.所有轴不进入standby模式
	MPU6050_Write_Reg_Value(MPU6050_PWR_MGMT_2,0x00);
	//4.采样率500Hz
	/*
	The Sample Rate is generated by dividing the gyroscope output rate by SMPLRT_DIV: 
	Sample Rate = Gyroscope Output Rate / (1 + SMPLRT_DIV) 
	where Gyroscope Output Rate = 8kHz when the DLPF is disabled (DLPF_CFG = 0 or 7), and 1kHz 
	when the DLPF is enabled (see Register 26). 
	
	*/
	MPU6050_Write_Reg_Value(MPU6050_SMPLRT_DIV,0x01); //DLPF低通滤波要开 --> 500Hz
	
	//5.开启低通滤波
	MPU6050_Write_Reg_Value(MPU6050_CONFIG,0x03);
	//6.角速度量程配置 -->   ± 2000 °/s 
	MPU6050_Write_Reg_Value(MPU6050_GYRO_CONFIG,0x18);
	
	//7.加速度量程配置 -->   ± 4g 
	MPU6050_Write_Reg_Value(MPU6050_ACCEL_CONFIG,0x08);
	 
	
}


uint8_t MPU6050_Who_Am_I(void)
{
	
	return MPU6050_Read_Reg_Value(117);
}


//获取MPU6050的原始寄存器数据
void MPU6050_GetRawData(MPU6050_DataTypedef *data)
{
//	//1.开始
//	MyI2C_Start();
//	//2.指定地址写 
//	MyI2C_SendByte(0x68<<1 | 0x00);  // 7位地址 + 1位的读写位
//	//3.接收MPU6050的应答
//	uint8_t ack = MyI2C_RecACK();
//	//4.发送寄存器地址
//	MyI2C_SendByte(MPU6050_ACCEL_XOUT_H);
//	//5.接收MPU6050的应答
//	MyI2C_RecACK();
//	//6.发一个开始
//	MyI2C_Start();
//	//7.指定地址读
//	MyI2C_SendByte(0x68<<1 | 0x01);  // 7位地址 + 1位的读写位
//	//8.接收MPU6050的应答
//	MyI2C_RecACK();
//	
//	for(uint8_t i=0;i<7;i++)
//	{
//		//接收MPU6050的ACCEL_XOUT_H字节		
//		*((int16_t *)data+i)  = ((uint16_t)MyI2C_RecByte())<<8;
//		//发送应答
//		MyI2C_SendACK(0);
//	
//		//接收MPU6050的ACCEL_XOUT_L字节
//		*((int16_t *)data+i) += MyI2C_RecByte(); //这么写也是可以的data->ACCEL_XOUT |= MyI2C_RecByte();
//		//发送应答 --> 最后的位置不能给应答
//		if(i<6)
//		{
//			MyI2C_SendACK(0); //应答
//		}else
//		{
//			MyI2C_SendACK(1); //非应答
//		}		
//		
//	}
//	
//	//11.协议结束
//	MyI2C_Stop();


	//1.开始
	I2C_GenerateSTART(I2C2,ENABLE);
	//等待EV5事件
	while(I2C_CheckEvent(I2C2,I2C_EVENT_MASTER_MODE_SELECT)!=SUCCESS);	
	//2.指定地址写 
	I2C_Send7bitAddress(I2C2,0x68<<1,I2C_Direction_Transmitter);
	//等待EV6事件
	while(I2C_CheckEvent(I2C2,I2C_EVENT_MASTER_TRANSMITTER_MODE_SELECTED)!=SUCCESS);
	
	//3.发送寄存器地址
	while(I2C_CheckEvent(I2C2,I2C_EVENT_MASTER_BYTE_TRANSMITTING)!=SUCCESS); //等待数据寄存器空
	I2C_SendData(I2C2,MPU6050_ACCEL_XOUT_H);	
	
	
	//5.发送重复的开始信号
	I2C_GenerateSTART(I2C2,ENABLE);
	//等待EV5事件
	while(I2C_CheckEvent(I2C2,I2C_EVENT_MASTER_MODE_SELECT)!=SUCCESS);	
	//6.指定地址读 
	I2C_Send7bitAddress(I2C2,0x68<<1,I2C_Direction_Receiver);	 //接收模式
	//等待EV6事件
	while(I2C_CheckEvent(I2C2,I2C_EVENT_MASTER_RECEIVER_MODE_SELECTED)!=SUCCESS);	//接收模式
	
	for(uint8_t i=0;i<7;i++)
	{
		
		while(I2C_CheckEvent(I2C2,I2C_EVENT_MASTER_BYTE_RECEIVED)!=SUCCESS); //等待EV7事件
		*((int16_t *)data+i)   = ((uint16_t)I2C_ReceiveData(I2C2))<<8;
		
		//最后一个字节前要处理EV7_1事件
		//EV7_1：RxNE=1，读DR寄存器清除该事件。设置ACK=0和STOP请求。
		
		if(i==6)
		{
			//(1)清除响应
			I2C_AcknowledgeConfig(I2C2,DISABLE);
			//(2)停止条件的产生位
			I2C_GenerateSTOP(I2C2,ENABLE);
		}		
		
		while(I2C_CheckEvent(I2C2,I2C_EVENT_MASTER_BYTE_RECEIVED)!=SUCCESS); //等待EV7事件
		*((int16_t *)data+i)  += I2C_ReceiveData(I2C2);
		
				
		
		//接收MPU6050的ACCEL_XOUT_H字节		
//		*((int16_t *)data+i)  = ((uint16_t)MyI2C_RecByte())<<8;
		//发送应答
//		MyI2C_SendACK(0);
	
		//接收MPU6050的ACCEL_XOUT_L字节
//		*((int16_t *)data+i) += MyI2C_RecByte(); //这么写也是可以的data->ACCEL_XOUT |= MyI2C_RecByte();
		//发送应答 --> 最后的位置不能给应答
//		if(i<6)
//		{
//			MyI2C_SendACK(0); //应答
//		}else
//		{
//			MyI2C_SendACK(1); //非应答
//		}	
		
		
	}
	
	
	I2C_AcknowledgeConfig(I2C2,ENABLE);//操作完毕后再打开，防止调用其他函数不能自动应答ack

	
}

